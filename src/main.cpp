// TP3: trained two-sensor Logistic Regression, generated by tp3.py.
#include <Arduino.h>
#include <DHT.h>
#include <math.h>

DHT dht(2, DHT22);
const int N_FEATURES = 2; // Temperature, then Humidity
const float MEAN[2] = {1.595311508e+01f, 4.857430185e+01f};
const float STD[2] = {1.435803848e+01f, 8.821187742e+00f};
const float WEIGHTS[2] = {-2.086760554e-01f, 9.679781404e-01f};
const float BIAS = 9.693804113e-01f;

float standardize(float value, int index) {
  return (value - MEAN[index]) / STD[index];
}

float sigmoid(float z) {
  // Numerically stable even for large positive/negative inputs.
  if (z >= 0) return 1.0f / (1.0f + expf(-z));
  const float e = expf(z);
  return e / (1.0f + e);
}

float predict(const float scaled[]) {
  float z = BIAS;
  for (int i = 0; i < N_FEATURES; ++i) z += WEIGHTS[i] * scaled[i];
  return sigmoid(z);
}

void setup() {
  Serial.begin(9600);
  dht.begin();
  pinMode(LED_BUILTIN, OUTPUT);
}

void loop() {
  delay(2000); // DHT22 needs at least two seconds between readings.
  const float temperature = dht.readTemperature();
  const float humidity = dht.readHumidity();
  if (isnan(temperature) || isnan(humidity)) {
    Serial.println(F("DHT read failed"));
    return;
  }
  const float scaled[2] = {standardize(temperature, 0), standardize(humidity, 1)};
  const unsigned long start = micros();
  const float probability = predict(scaled);
  const unsigned long inferenceUs = micros() - start;
  const int prediction = probability > 0.5f ? 1 : 0;
  digitalWrite(LED_BUILTIN, prediction ? HIGH : LOW);
  Serial.print(F("Temperature=")); Serial.print(temperature);
  Serial.print(F(" Humidity=")); Serial.print(humidity);
  Serial.print(F(" Probability=")); Serial.print(probability, 6);
  Serial.print(F(" Class=")); Serial.print(prediction);
  Serial.print(F(" Inference_us=")); Serial.println(inferenceUs);
}
